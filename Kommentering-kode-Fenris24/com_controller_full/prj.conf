## prj.conf
```kconfig
CONFIG_STDOUT_CONSOLE=y
CONFIG_GPIO=y
CONFIG_ADC=y
CONFIG_CAN=y
CONFIG_SPI=y
CONFIG_CAN_MCP2515=y
CONFIG_NRFX_TIMER0=y
CONFIG_NRFX_TIMER1=y
CONFIG_NEWLIB_LIBC=y
CONFIG_SERIAL=y
CONFIG_UART_INTERRUPT_DRIVEN=y
CONFIG_UART_CONSOLE=y
CONFIG_RING_BUFFER=y
```

## src/bt_controller.c
```c
#include "bt_controller.h"
#include <zephyr/sys/ring_buffer.h>
#include <zephyr/drivers/uart.h>
#include <zephyr/kernel.h>
#include <string.h>
#include <stdlib.h>
 // Commented and coded by OA

const struct device *const get_uart_dev(void){ // Fuction responsible for finding and accessing the UART/ HC-05 device
    return DEVICE_DT_GET(DT_NODELABEL(uart1)); // Returns the UART device by looking for it in the devicetree/ overlay file by label
}


static uint8_t ring_buffer_storage[RING_BUF_SIZE]; // Variable for storing the ring-buffer and its size
static struct ring_buf ringbuf; // Ring-buffer variable
static struct joystick_data last_received_data; // Last-received data variable
static bool new_data_available = false; // Variable used to represent if new data is available or not

struct joystick_data get_js_data(){ // Function that allows other parts of the program to access the received joystick data
    return last_received_data;
};

static void parse_joystick_data(char *data, struct joystick_data *joy_data) { // Function that parses/ filters out the isolated data from the uart callback function
    char *start = strchr(data, 'S'); // Searches for the first occurence of the character 'S' in the string, and the pointer 'start' will point to 'S' if found, or NULL if not
    char *end = strchr(data, 'E'); // Searches for the first occurence of the character 'E' in the string, and the pointer 'end' will point to 'E' if found, or NULL if not
    if (start && end && start < end) { // If test to check if both 'start' and 'end' are not NULL, and that 'start' is less than 'end', to make sure it comes in the right order
        *end = '\0'; // Terminate the string at the end delimiter
        joy_data->joystickId = (*(start + 1) - '0') != 0; // Extracts the character directlyn after 'S', converts it from ASCII to and integer, and checks if it is not zero, then assigns the value to the variable
        joy_data->x = atoi(start + 3); // Parses an integer staring from three characters after 'S', and thn assigning the value to the variable
        joy_data->y = atoi(strchr(start + 3, ',') + 1); // Finds the comma (',') following the X-values, parses the integer directly after the comma, and assigns the value into the Y-value variable
        new_data_available = true;  // Signal that new data is available
        last_received_data = *joy_data;  // Store the last received data
    }
}

void uart_fifo_callback(const struct device *dev, void *user_data) { // Function that reads data from UART FIFO buffer, processes it and isolates the desired data
    static char data_buffer[128]; // Buffer variable to hold incoming data
    static int data_pos = 0; // Variable for current position in buffer

    while (uart_irq_update(dev) && uart_irq_is_pending(dev)) { // While function that continues to run as long as there is available updates from the UART and there are pending interrupts
        if (uart_irq_rx_ready(dev)) { // If test to check if data is ready to be read
            uint8_t buffer[64]; // Temporary buffer to store data
            int recv_len = uart_fifo_read(dev, buffer, sizeof(buffer)); // Reads data into a temporary buffer and then returnes the number of bytes read
            if (recv_len > 0) { // If test checking if the length of the received buffer is greater than zero
                // Append data to buffer
                for (int i = 0; i < recv_len; i++) { // For-loop running as long as the position read in the buffer is less than the length of the buffer
                    if (buffer[i] == 'S') { // If test that checks for the start of a new packet
                        data_pos = 0; // Reset data position if found
                    }
                    if (data_pos < sizeof(data_buffer) - 1) { // If test that adds data to the data_buffer, while ensuring it does not overflow
                        data_buffer[data_pos++] = buffer[i];
                    }
                    if (buffer[i] == 'E') { // End of packet found, process data
                        data_buffer[data_pos] = '\0'; // Null terminate
                        parse_joystick_data(data_buffer, &last_received_data); // Call for using the function parse_joystick_data
                        data_pos = 0; // Reset for next packet
                    }
                }
            }
        }
    }
}


void process_joystick_data() { // Function that checks if there is new available data
    if (new_data_available) { // If test to check if there is new data available
        //printk("Using joystick data: ID=%d, X=%d, Y=%d\n", last_received_data.joystickId, last_received_data.x, last_received_data.y);
        new_data_available = false;  // Sets the new data variable to false, indicating that there is no new data available at this point
    }
}

void configure_uart(const struct device *dev) { // Fucntion for setting up interrupt-driven UART communication using a ring-buffer
    uart_irq_callback_set(dev, uart_fifo_callback); // Callback function that will be triggered by interrupts
    uart_irq_rx_enable(dev); // Function that enables the receive interrupt for the device, triggering the callback function when there is new data comming in
    ring_buf_init(&ringbuf, RING_BUF_SIZE, ring_buffer_storage); // Buffer used to store incoming data
}

void btBegin(){ // Function responcible for the initialization, configuration and startup of the UART/ HC-05 device
    const struct device *const uart_dev = get_uart_dev(); // Getting the UART device
    if (!device_is_ready(uart_dev)) { // If test checking if the UART device is ready or not
        printk("UART device is not ready\n");
        return;
    }

    configure_uart(uart_dev); // Calling upon the configure_uart function
    printk("Starting to receive data...\n");
}
```

## src/canbus.h
```c
#ifndef __CANBUS_H
#define __CANBUS_H
#include <zephyr/drivers/can.h>

// Commented and coded by OA

//can_dev
const struct device *const get_can_dev(void); // Function for getting the CAN device

//can_receive
#define RECEIVE_ID_STR 0x0000002 // RECEIVE ID matching the message ID of the motor frame
#define RECEIVE_ID_BYTE 0x0000003 // RECEIVE ID matching the message ID of the sensor frame

int setup_can_filter(const struct device *dev, can_rx_callback_t rx_cb, void *cb_data); // Function for setting up the CAN filter

void can_rx_callback(const struct device *dev, struct can_frame *frame, void *user_data); // Function for looking at CAN frames on the bus, and retreiving them
uint8_t get_sensor_byte(); // Function for accessing the sensor byte sent over the bus from the sensor node
//can_send
#define MSG_ID 0x0000001 // Message ID of the frame

const char* can_state_to_str(enum can_state state); // Function that converts the CAN states to string
void send_custom_data (const struct device *can_dev, uint8_t js_bool, int16_t js_deg_int, int16_t js_spd_int); // Function for sending a CAN frame with joystick data 

void canBegin(void); // Function for initializing and starting the CAN device
#endif
```

## src/math_calc.c
```c
#include <math.h>
#include "math_calc.h"
// Funksjonen tar inn rå potmeter verdi sendt fra kontroller (0 til 1023)
struct ProjectionResult stereographic_projection_2D(int x, int y){
    // Trekker fra 512 (1023/2) fra x og y. Må finne midtpunkt og ha muligheten til å ha negative akse-verdier for å senere bruke verdier i enhetssirkel.
    int unit_x = x - 512;
    int unit_y = y - 512;

    // Finner forholdet mellom x og y verdi
    double a = (double)y / (double)x;

    // Trigonometrisk formel for å finne x i en sirkel vha forholdet mellom x og y i en firkant
    double temp_x = 1 / sqrt(1 + (a * a));

    // Finner y-verdi ved å bruke forholdet mellom x og y i en firkant, og multipliserer med ny x-verdi
    double temp_y = a * temp_x;
    
    // lager en variabel som kan holde resultatene fra funksjonen
    struct ProjectionResult result;

    // Oppdaterer variablen med resultatene utregnet i funksjonen
    result.x = (int)(temp_x * unit_x);
    result.y = (int)(temp_y * unit_y);

    // Funksjon som sjekker etter fortegnsfeil etter omforming av verdier
    if ((unit_y > 29 && result.y < 29) || (unit_y < -29 && result.y > 29)){
        result.y = (result.y * -1);
    }
    
    // Returnerer variablen
    return result;
}

// Denne funksjonen på få inn stereografisk projeksjonerte x og y verdier
int calculate_angle_degrees(int x, int y){
    // Lager variabler som lagrer x og y midlertidig
    int temp_x = x;
    int temp_y = y;

    // Funksjon for å definere dødsonen til joystick i x-retning
    if ((-40 < x) && (x < 41)){
        temp_x = 0;
    }
    // Funksjon for å definere dødsone til joystick i y-retning
    if ((-28 < y) && (y < 29)){
        temp_y = 0;
    }

    // Sikkerhetslag i tilfelle joystick-verdiene kommer utenfor maks område i negativ og positiv retning
    if (x > 512){temp_x = 512;}
    if (x < -512){temp_x = -512;}
    if (y > 512){temp_y = 512;}
    if (y < -512){temp_y = -512;}

    // Lager variabel som skal holde vinkelen målt i radianer. Variabelen settes lik resultatet av en atan2 funksjon med x og y som parametere
    double angle_radians = atan2(temp_x, temp_y);

    // Lager variabel som skal holde vinkel målt i grader. Variabelen settes lik radianer utregnet omgjort til vinkel
    double angle_degrees = ((angle_radians * 180) / 3.14159);

    //atan2 gir vinkel fra -180 til 180 grader. Denne funksjonen omgjør negativ vinkel til vinkler over 180 grader. Slik at 0-360 grader oppnåes.
    if (angle_degrees < 0){angle_degrees += 360.0;}

    // returnerer utregnet vinkel
    return (int)angle_degrees;
}

// Funksjon som regner på punkt(x,y) sin lengde fra origo. Bruker vanlig pytagoras setning h = sqrt(k1*k1 + k2*k2)
int calculate_radius(int x, int y){
    // lager variabler midlertidig for å holde verdiene.
    int temp_x = x;
    int temp_y = y;

    // Sjekk for å definere dødsone fra joystick
    if ((-40 < x) && (x < 40)){
        temp_x = 0;
    }
    if ((-40 < y) && (y < 40)){
        temp_y = 0;
    }

    // lager variabel som holder resultatet utregnet etter pytagoras sin setning
    double radius = sqrt((temp_x * temp_x) + (temp_y * temp_y));

    // Returnerer punktets lengde fra origo
    return (int)radius;
}


int scale_to_percent(int number, int max_value){
    // Lager variabel som holder det skalerte tallet etter prosentutregning.
    double scaled_number = ((double)number / (double)max_value) * 100.0;

    // Returnerer tall som beskriver hvor stort number er iforhold til max_value
    return (int)(scaled_number);
}
```
