## CMakeLists.txt
```
cmake_minimum_required(VERSION 3.20.0)
find_package(Zephyr REQUIRED HINTS $ENV{ZEPHYR_BASE})

project(motorkontroller)

target_sources(app PRIVATE src/main.c src/motorstyring.c src/pwm.c src/canbus.c)
```

## prj.conf
```kconfig
CONFIG_STDOUT_CONSOLE=y
CONFIG_GPIO=y
CONFIG_ADC=y
CONFIG_PWM=y
CONFIG_PWM_LOG_LEVEL_DBG=y
CONFIG_CAN=y
CONFIG_CAN_MCP2515=y
CONFIG_SPI=y
CONFIG_CONSOLE=y
CONFIG_NEWLIB_LIBC=y
CONFIG_NEWLIB_LIBC_FLOAT_PRINTF=y
```

## src/main.c
```c
#include <math.h>
#ifndef M_PI
#define M_PI 3.14159265358979323846
#endif
#include <zephyr/kernel.h>
#include <zephyr/drivers/can.h>
#include <zephyr/drivers/gpio.h>
#include <zephyr/drivers/spi.h>
#include <zephyr/device.h>
#include <stdbool.h>
#include <string.h>
#include <stdio.h>
#include "pwm.h"
#include "motorstyring.h" //lagt til av RAS(PROWLTECH25)
#include "canbus.h"
// Commented and coded by OA and EAH


void main(void) {
    printf("Starter CAN...\n");
    const struct device *const can_dev = get_can_dev(); // Getting the CAN device connected to the system
    canBegin(can_dev); // Function for startring up and initializing the CAN device
    printf("CAN er klar. \n");

    int ret2 = pwm_begin();
    if(ret2 < 0){
        printf("\nError initializing PWM. Error code = %d\n", ret2);
        while(1);
    }

    printf("PWM er klar.\n");

    k_msleep(10);

    while (1) {
        printf("In the while loop\n");
        canState(can_dev);// Function for checking the CAN state
        process_can_data(); // Using the process_can_data function
        if (er_nødstopp_aktivert()) { 
            printf("nødstopp aktivert\n"); // RAS og linja over
        }

        send_string(can_dev, "Hello"); // Using the send_string function to send the string "Hello"
        k_msleep(50); // Sleep for 50ms, letting the callback handle messages
    }
}
```

## src/canbus.c
```c
#define M_PI 3.14159265358979323846
#include <math.h>
#include <stdio.h>
#include <zephyr/sys/byteorder.h>

#include <zephyr/kernel.h>
#include <zephyr/drivers/can.h>
#include <zephyr/drivers/spi.h>
#include <zephyr/drivers/gpio.h>
#include <zephyr/device.h>
#include <stdbool.h>
#include <string.h>
#include "canbus.h"
#include "motorstyring.h" 


static int64_t siste_mottatt_tid = 0; //tidspunkt for siste mottatte melding(RAS)

 //lagt til av RAS (PROWLTECH25)
//Motorstyringen i denne filen er endret av RAS(PROWLTECH25)
// Commented and coded by OA



void canBegin(const struct device *can_dev){ // Function for startring up and initializing the CAN device
    //const struct device *const can_dev = get_can_dev(); // Getting the CAN device connected to the system
    
    if (!can_dev) { // Test that checks if the CAN device is found. If not it will print the error message and return
        printk("Cannot find CAN device!\n");
        return;
    }

    int ret = can_start(can_dev); // Starting up the CAN device
    if (ret != 0) { // Check to see if the CAN device has started, if not it will print the error message and return
        printf("Failed to start CAN controller: Error %d\n", ret);
        return;
    }
    if (setup_can_filter(can_dev, can_rx_callback, NULL) < 0) { // Check to see if the CAN filter is set up or not
        printk("Failed to add CAN filter\n");
        return;
    }
}

void canState(const struct device *can_dev){ // Function for checking the CAN state
    enum can_state state; // Defines the state of the CAN controller
    struct can_bus_err_cnt err_cnt; // CAN controller error counter
    if (can_get_state(can_dev, &state, &err_cnt) != 0) { // If test to check the state of the CAN controller
            printk("Failed to get CAN state\n");
        } else {
        printf("CAN State: %s\n", can_state_to_str(state));
        printf("TX Errors: %d, RX Errors: %d\n", err_cnt.tx_err_cnt, err_cnt.rx_err_cnt);
        }
}

//RAS(PROWLTECH25) Laget ny versjon for å håndtere ny data
void process_can_data(void) {
    struct can_ret_data received_data;
    if (k_msgq_get(&can_msgq, &received_data, K_FOREVER) == 0) {
        printk("Prosesserer CAN data: Fart=%.2f, Vinkel=%.2f, Rotasjon=%.2f\n", received_data.fart, received_data.vinkel, received_data.rotasjon);
        kontroller_motorene(received_data.fart, received_data.vinkel, received_data.rotasjon);
    }
}



//can_dev functions
const struct device *const get_can_dev(void){ // Fuction responsible for finding and accessing the CAN device
    return DEVICE_DT_GET(DT_CHOSEN(zephyr_canbus)); // Returns the CAN device by looking for it in the devicetree/ overlay file under "chosen"
} 

//can_receive functions
K_MSGQ_DEFINE(can_msgq, sizeof(struct can_ret_data), CAN_MSGQ_SIZE, 4); // Message queue function for putting the joystick values received from the com controller node in

int setup_can_filter(const struct device *dev, can_rx_callback_t rx_cb, void *cb_data){ // Function for setting up the can filter, taking in the CAN device, callback function and cb data
    struct can_filter filter = { // CAN filter for the joystick values
        .flags = CAN_FILTER_DATA | CAN_FILTER_IDE, // Setting the flags for the filter, where the filter matches the data frames, and that the filter matches CAN frames with extended ID (29-bit)
	    .id = RECEIVE_ID, // Filter ID set to match the sender ID of the joystick values, defined in the header file
	    .mask = CAN_EXT_ID_MASK // Filter bit mask for an extended 29-bit CAN ID
    };
    return can_add_rx_filter(dev, rx_cb, cb_data, &filter); // Returning the rx filter
}

//can_send functions

/* Function to convert CAN state to readable string */
const char* can_state_to_str(enum can_state state) {
    switch (state) {
        case CAN_STATE_ERROR_ACTIVE:
            return "ERROR ACTIVE";
        case CAN_STATE_ERROR_WARNING:
            return "ERROR WARNING";
        case CAN_STATE_ERROR_PASSIVE:
            return "ERROR PASSIVE";
        case CAN_STATE_BUS_OFF:
            return "BUS OFF";
        case CAN_STATE_STOPPED:
            return "STOPPED";
        default:
            return "UNKNOWN";
    }
}

void send_string(const struct device *can_dev, const char *str){ // Function for sending a string over the bus
    struct can_frame frame; // Using a CAN frame struct called frame
    memset(&frame, 0, sizeof(frame)); // Zeros out the frame to ensure that all bits starts in a knwown state

    frame.flags = CAN_FRAME_IDE; // Use extended identifier
    frame.id = MSG_ID; // Using the message ID for the frame that is defined in the header file
    frame.dlc = strlen(str);  // Set the DLC to the string length
    memcpy(frame.data, str, frame.dlc);  // Copies the string to the CAN frame data field

    if (can_send(can_dev, &frame, K_SECONDS(10), NULL, NULL) != 0) { // If test that sends the frame on the bus, and prints out a warning if it failes
            printk("Failed to send frame\n");
        } /*else {
            printk("Frame sent\n");
        }*/
}

// cezar husk å kommentere og endre
void can_rx_callback(const struct device *dev, struct can_frame *frame, void *user_data) {
    // Sjekk at vi faktisk fikk 8 byte som forventet
    if (frame->id == RECEIVE_ID && frame->dlc == 8) {

        siste_mottatt_tid = k_uptime_get();
        sett_nødstopp(false);  

        // Debug: print rå data
        printf("RÅ CAN-data (hex): ");
        for (int i = 0; i < frame->dlc; i++) {
            printf("%02X ", frame->data[i]);
        }
        printf("\n");

        // Lese inn 4x int16_t fra frame->data, liten endian
        int16_t fart_i      = sys_le16_to_cpu(*(int16_t *)&frame->data[0]);
        int16_t vinkel_i    = sys_le16_to_cpu(*(int16_t *)&frame->data[2]);
        int16_t rotasjon_i  = sys_le16_to_cpu(*(int16_t *)&frame->data[4]);
        int16_t sving_js_i  = sys_le16_to_cpu(*(int16_t *)&frame->data[6]);

        float fart      = fart_i / 100.0f;
        float vinkel    = vinkel_i / 100.0f;
        float rotasjon  = rotasjon_i / 100.0f;
        float sving_js  = sving_js_i / 100.0f;

        printf("[PI → Motor-MB] Mottatt:\n");
        printf("  Fart      : %.2f\n", fart);
        printf("  Vinkel    : %.2f°\n", (vinkel * 180.0f / (float)M_PI));
        printf("  Rotasjon  : %.2f\n", rotasjon);
        printf("  Sving JS  : %.2f\n", sving_js);
        printf("-----------------------------\n");

        kontroller_motorene(fart, vinkel, rotasjon); // legg evt. til sving_js

    } else {
        printf("CAN frame ignorert: ID 0x%X, DLC %d\n", frame->id, frame->dlc);
    }
}
```

## src/canbus.h
```c
#ifndef CANBUS_H
#define CANBUS_H
#include <zephyr/drivers/can.h>
// Commented and coded by OA

void canBegin(const struct device *can_dev); // Function for initializing and starting the CAN device

void canState(const struct device *can_dev); // Function for checking the CAN state

void process_can_data(void); // Function for processing the receievd CAN data 

//can_dev functions
const struct device *const get_can_dev(void); // Function for getting the CAN device

//can_receive functions
#define RECEIVE_ID 0x0000001 // RECEIVE ID
#define CAN_MSGQ_SIZE 10 // Message queue size

// cezar husk å kommentere og endre
void can_rx_callback_pi(const struct device *dev, struct can_frame *frame, void *user_data);

//RAS(PROWLTECH) laget ny struct for å ta imot verdier på vår måte, fart, vinkel og rotasjon
struct can_ret_data {  //struct for å motta data
    float vinkel;
    float fart;
    float rotasjon;

};


extern struct k_msgq can_msgq; // Message queue structure

int setup_can_filter(const struct device *dev, can_rx_callback_t rx_cb, void *cb_data); // Function for setting up the can filter, taking in the CAN device, callback function and cb data

void can_rx_callback(const struct device *dev, struct can_frame *frame, void *user_data); // Function for checking CAN frames on the bus


//can_send functions
#define MSG_ID 0x0000002 // Message ID 

const char* can_state_to_str(enum can_state state); // Function that converts the CAN states to string
void send_string(const struct device *can_dev, const char *str); // Function for sending a string over the bus


#endif
```

## src/motorkontroller.h
```c
#ifndef MOTORCONTROLLER_H
#define MOTORCONTROLLER_H
#include <stdbool.h> //bibliotek for å kunne bruke bools

//funksjon for å kontrollere motorene
int control_motors(int angle, int speed, bool joystick_nr);

//funksjon for å skalere og velge rotasjonsretning til motor
int mapValue(int value, int direction);

//funksjon for å skalere ønsket duty cycle i prosent til en brøk av perioden.
int speed_to_ds(int duty_cycle);
#endif
```

## src/motorstyring.c
```c
#include "motorstyring.h"
#include "pwm.h" //for å kunne bruke pwm_write så motorene forstår signalene vi sender
#include <math.h> //for å få tilgang til mattefunksjoner
#ifndef M_PI //for å definere pi så vi kan bruke til vinkelberegning (er ikke definert i math.h)
#define M_PI 3.14159265358979323846
#endif
#include <stdio.h> // for å bruke printf og skrive ut
#include <stdlib.h> // for tilgang til minnehåndtering
#include <stdbool.h>
#define MOTOR_ID_FRONT_LEFT 0
#define MOTOR_ID_FRONT_RIGHT 1
#define MOTOR_ID_REAR_LEFT 2
#define MOTOR_ID_REAR_RIGHT 3

//laget av ras (husk å kommentere)
//Global flagg for nødstopp - under arbeid
static bool nødstopp = false;

void sett_nødstopp(bool aktivert) {
    nødstopp = aktivert;

    if (aktivert) {
        printf("nødstopp aktivert! alle motor stoppes.\n");
        int stopp_pwm = speed_to_ds(mapValue(0, 1));
        for (int i = 0; i < 4; ++i) {
            pwm_write(i, stopp_pwm);
        }

    } else {
        printf("Nødstopp deaktivert. Motorer aktive igjen.\n");
    }

}


bool er_nødstopp_aktivert(){
    return nødstopp;
}


//ny versjon for mapValue og pwm-verktøy

int mapValue (int prosent, int retning){
    int min = 50;
    int diff = prosent * 0.4f; // 0-100 - > 0-40

    if (retning == 1) return min + diff; //fremover
    if (retning == 2) return min - diff; // bakover
    return 50; // default setting
}

int speed_to_ds(int duty_cycle) {
    int periode = 40000000; // 40ms = 25 hz
    return ((duty_cycle * (periode / 10)) /10); //(duty cycle / 100) * periode

}

//funksjon som beregn motorverdier fra fart, vinkel og rotasjon. regner ut hvor mye hver av de 4 motorene skal kjøre.
//basert på fart(hvor fort vi vil kjøre fra 0 til 1), 
//vinkel(hvilken retning vi vil kjøre. for eks 0 er fremover og pi/2 er til venstre),
//rotasjon(rotasjon av hele bilen, positiv=høyre og negativ=venstre)

 struct MotorVerdier kalkulerMotorVerdier(float fart, float vinkel, float rotasjon) {
    float x = fart * cosf(vinkel); //her regner vi fart og vinkel om til x kordinater
    float y = fart * sinf(vinkel); //her regner vi fart og vinkel om til y kordinater

    float justert_rotasjon = rotasjon * fart; //gir dynamisk rotasjon

    float front_left = y + x + justert_rotasjon; //regner ut hvor mye hver motor må bidra for at hele bilen skal bevege seg riktig. 
    float front_right = y - x - justert_rotasjon; //mecanum hjulene kombinerer for å få dette til.
    float rear_left =  y - x + justert_rotasjon;
    float rear_right = y + x - justert_rotasjon;

    printf("beregnet motorverdier: front_left = %.2f, front_right = %.2f, rear_left = %.2f, rear_right = %.2f\n", front_left, front_right, rear_left, rear_right); //skriver ut det som har blitt beregnet, viktig info når man feilsøker.
   
    //hvis en av verdiene er større enn 1.0 deler vi alle på den største verdien, så de skaleres ned til mellom -1 og 1. dette er kalt normalisering.
    float max_val = fmaxf(fmaxf(fabsf(front_left), fabsf(front_right)), fmaxf(fabsf(rear_left), fabsf(rear_right)));

    if (max_val > 1.0f) {
        printf("Normaliserer motorverdier. Max verdi før: %.2f\n", max_val);
        front_left /= max_val;
        front_right /= max_val;
        rear_left /= max_val;
        rear_right /= max_val;
    }

    //sjekker kraft - feilsøkinger
    float gjennomsnitt = (fabsf(front_left) + fabsf(front_right) + fabs(rear_left) + fabs(rear_right)) / 4.0f;

    if (fabs(front_left) > gjennomsnitt * 1.5f)
        printf("Advarsel: front_left motor bruker mer kraft enn snittet\n");
    
    if (fabs(front_right) > gjennomsnitt * 1.5f)
        printf("Advarsel: front_right motor bruker mer kraft enn snittet\n");
    
    if (fabs(rear_left) > gjennomsnitt * 1.5f)
        printf("Advarsel: rear_left motor bruker mer kraft enn snittet\n");

    if (fabs(rear_right) > gjennomsnitt * 1.5f)
        printf("Advarsel: rear_right motor bruker mer kraft enn snittet\n");
    
    if (fabs(front_left) < 0.05f && gjennomsnitt > 0.2f)
        printf("Advarsel: front_left motor bidrar lite mens de andre jobber\n");
    
    if (fabs(front_right) < 0.05f && gjennomsnitt > 0.2f)
        printf("Advarsel: front_right motor bidrar lite mens de andre jobber\n");

    if (fabs(rear_left) < 0.05f && gjennomsnitt > 0.2f)
        printf("Advarsel: rear_left motor bidrar lite mens de andre jobber\n");
    
    if (fabs(rear_right) < 0.05f && gjennomsnitt > 0.2f)
        printf("Advarsel: rear_right motor bidrar lite mens de andre jobber\n");


    struct MotorVerdier motorVerdier = {front_left, front_right, rear_left, rear_right}; // struct med 4 motorverdiene og returnerer den.
    return motorVerdier;

}


 static float gjeldende_fart = 0.0f;
 static float gjeldende_vinkel = 0.0f;
 static float gjeldende_rotasjon = 0.0f;
 static const float endring_per_steg = 0.05f;

//Hovedfunksjonen som konverterer bevegelse til PWM-signal, denne blir kalt når motorene skal kjøre.


int kontroller_motorene(float ønsket_fart, float ønsket_vinkel, float ønsket_rotasjon) {
    printf("kontrollerer motorene. Fart: %.2f, Vinkel: %.2f, rotasjon: %.2f\n", ønsket_fart, ønsket_vinkel, ønsket_rotasjon); //printer ut hvilke kommandoer vi har fått

    if (nødstopp) {
        printf("Nødstopp aktiv - motorstyring stoppes.\n");
        return -1;
    }

    if (!isfinite(ønsket_fart) || !isfinite(ønsket_vinkel) || !isfinite(ønsket_rotasjon)) {
        printf("Feil: en eller flere inputverdier er uendelige (inf) eller NaN\n");
        return -1;
    }

    //sjekker om at vinklene som kommer inn ikke er rare. Vinkelen bør være mellom -pi og pi.
    if (ønsket_vinkel < -M_PI || ønsket_vinkel > M_PI) {
        printf("Vinkelen som kom inn er utenfor forventet område: %.2f rad\n", ønsket_vinkel);
    }

    if (ønsket_fart < 0.0f || ønsket_fart > 1.0f) {
        printf("Advarsel: Fart utenfor gyldig område (0.0-1.0): %.2f\n", ønsket_fart);
    }

    if (ønsket_rotasjon < -1.0f || ønsket_rotasjon > 1.0f) {
        printf("Advarsel: Rotasjon utenfor gyldig område (-1.0 - 1.0): %.2f\n", ønsket_rotasjon);

    }

    //Rotasjonssjekk - unngå overdominans av rotasjon

    if (fabs(ønsket_rotasjon) > ønsket_fart * 2.0f && ønsket_fart > 0.1f) {
        printf("Advarsel: Rotasjon dominerer over fart, det kan gi spin eller ubalanse\n");
    }

    // Jevn_sving: Oppdater fart, rotasjon og vinkel
    if (gjeldende_fart < ønsket_fart) {
        gjeldende_fart += endring_per_steg;
        if (gjeldende_fart > ønsket_fart) gjeldende_fart = ønsket_fart;
     } else if (gjeldende_fart > ønsket_fart) {
        gjeldende_fart -= endring_per_steg;
        if (gjeldende_fart < ønsket_fart) gjeldende_fart = ønsket_fart;
    }

    if (gjeldende_vinkel < ønsket_vinkel) {
        gjeldende_vinkel += endring_per_steg;
        if (gjeldende_vinkel > ønsket_vinkel) gjeldende_vinkel = ønsket_vinkel;
    } else if (gjeldende_vinkel > ønsket_vinkel) {
        gjeldende_vinkel -= endring_per_steg;
        if (gjeldende_vinkel < ønsket_vinkel) gjeldende_vinkel = ønsket_vinkel;
    }
    
    if (gjeldende_rotasjon < ønsket_rotasjon) {
        gjeldende_rotasjon += endring_per_steg;
        if (gjeldende_rotasjon > ønsket_rotasjon) gjeldende_rotasjon = ønsket_rotasjon;
    } else if ( gjeldende_rotasjon > ønsket_rotasjon) {
        gjeldende_rotasjon -= endring_per_steg;
        if (gjeldende_rotasjon < ønsket_rotasjon) gjeldende_rotasjon = ønsket_rotasjon;
    }

    //jevn stopp, når fart og rotasjon går mot null
    if (ønsket_fart < 0.01f && fabsf(ønsket_rotasjon) < 0.01f && (gjeldende_fart > 0.0f || fabsf(gjeldende_rotasjon) > 0.0f)) {
        printf("Ønsket fart og rotasjon går mot null, bremser jevnt\n");
        ønsket_fart = 0.0f;
        ønsket_rotasjon = 0.0f;
        gjeldende_vinkel = gjeldende_vinkel; //vinkelen beholdes under brems
    }

    // stopp motorene helt hvis alt er 0

    if (gjeldende_fart < 0.01f && fabsf(gjeldende_rotasjon) < 0.01f) { // Hvis det er ingen bevegelse eller rotasjon så skal motorene stoppes.
        printf("Motorene står stille. Fart: %.2f, rotasjon: %.2f\n", gjeldende_fart, gjeldende_rotasjon);
        int mapped = mapValue(0, 1);
        int pwm_duty = speed_to_ds(mapped);
        for (int i = 0; i < 4; ++i) {
            printf("Stopp: Motor %d, mapValue %d, PWM-verdi: %d\n", i, mapped, pwm_duty);
            pwm_write(i, pwm_duty);
            
        }
        printf("Står stille\n");
        return 0;
    }

    printf("motorene beveger seg jevnt. Fart: %.2f, vinkel: %.2f, rotasjon: %.2f\n", gjeldende_fart, gjeldende_vinkel, gjeldende_rotasjon);

    struct MotorVerdier motorVerdier = kalkulerMotorVerdier(gjeldende_fart, gjeldende_vinkel, gjeldende_rotasjon); //kalkulerer hva alle 4 motorene skal gjøre basert på fart,vinkel og rotasjon.
    float motorer[4] = { //legger verdiene i en array så samme gjøres for hver motor
        motorVerdier.front_left,
        motorVerdier.front_right,
        motorVerdier.rear_left,
        motorVerdier.rear_right

    };



    int pins[4] = {MOTOR_FRONT_LEFT, MOTOR_FRONT_RIGHT, MOTOR_REAR_LEFT, MOTOR_REAR_RIGHT}; //hver motor er koblet til en pin, definert i pwm.h

    

    for (int i = 0; i < 4; ++i) { //for løkke som går en gang per motor
        if (pins[i] < 0 || pins[i] > 10) {
            printf("Feil: ugyldig motorpin: %d for motor %d\n", pins[i], i);
            continue;
        }
    

        int retning = (motorer[i] >= 0.0f) ? 1 : 2; //hvis verdien er positiv er retningen fremover(1) og bakover hvis den er negativ(2).
        float fartsverdi = fabsf(motorer[i]) * 100.0f; //0-100% (gjør verdien om til prosent)

        int mapped = mapValue((int)fartsverdi, retning); //konverterer fart + retning til pwm duty-cycle. (hvor mye strøm motoren skal få)
        if (mapped < 0) {
            printf("Feil: mapvalue() returnerte negativ verdi: %d for motor %d\n", mapped, i);
        }

        int pwm_duty = speed_to_ds(mapped); //gjør duty-cycle om til tidsverdi i nanosekunder som pwm_write() kan bruke.
        if (pwm_duty < 0) {
            printf("Feil: speed_to_Ds() returnerte negativ verdi: %d for motor %d\n", pwm_duty, i);
        }

        printf("Motor: %d, Retning: %d, Fart: %.2f, mapValue: %d, PWM-verdi: %d\n", i, retning, fartsverdi, mapped, pwm_duty);
        pwm_write(pins[i], pwm_duty); //sender signalet til riktig motor
    }

    printf("Kjører fart: %.2f, vinkel: %.2f rad, rotasjon: %.2f\n", gjeldende_fart, gjeldende_vinkel, gjeldende_rotasjon);
    return 0;
}


//TODO under testing: -Prøve dynamisk endring_per_steg, -legg til toleranse på små forskjeller, -juster svingrespons
```

## src/motorstyring.h
```c
//Laget av RAS (husk å kommentere)
#ifndef MOTORSTYRING_H
#define MOTORSTYRING_H
#include <stdbool.h>


struct MotorVerdier {
    float front_left;
    float front_right;
    float rear_left;
    float rear_right;
};

struct MotorVerdier kalkulerMotorVerdier(float fart, float vinkel, float rotasjon);
int kontroller_motorene(float fart, float vinkel, float rotasjon);
void sett_nødstopp(bool aktivert);
bool er_nødstopp_aktivert();

int speed_to_ds(int duty_cycle);
int mapValue(int prosent, int retning);


#endif //MOTORSTYRING_H
```

## src/pwm.h
```c
#ifndef __PWM_H
#define __PWM_H
#include <stdint.h>

// Definerer perioden for hvert PWM-signal i nano-sekunder
#define PWM_PERIOD_NS 40000000

// Funksjon for å initialisere PWM og oppsett. Hvilke "channels" og "pins" som brukes.
int pwm_begin();

// Funksjon for å sette PWM signal på en pin manuelt. Den repeterer signalet helt til den
// får ordre om noe annet
void pwm_write(int motor_pin, uint32_t value);

// Definerer hvilke motor som bruker hvilken kanal på microbiten (Det er maks 4 PWM kanaler per microbit)
// Venstre fremre motor bruker kanal 0, høyre fremre bruker kanal 1,
// venstre bakre motor bruker kanal 2, og høyre bakre motor bruker kanal 3.
#define MOTOR_FRONT_LEFT 0
#define MOTOR_FRONT_RIGHT 1
#define MOTOR_REAR_LEFT 2
#define MOTOR_REAR_RIGHT 3

#endif
```
